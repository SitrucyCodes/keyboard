#include "Joose.dtsi"

&transform0 {
    col-offset = <6>;
};

&kscan {
    col-gpios
        = <&gpio0 15 GPIO_ACTIVE_HIGH>
        , <&gpio0 2 GPIO_ACTIVE_HIGH>
        , <&gpio0 29 GPIO_ACTIVE_HIGH>
        , <&gpio0 31 GPIO_ACTIVE_HIGH>
        , <&gpio0 8 GPIO_ACTIVE_HIGH>
        , <&gpio1 6 GPIO_ACTIVE_HIGH>
        ;
};
