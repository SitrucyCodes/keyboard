#include "Joose.dtsi"

&kscan {
    col-gpios
        = <&gpio0 06 GPIO_ACTIVE_HIGH>
        , <&gpio0 08 GPIO_ACTIVE_HIGH>
        , <&gpio0 31 GPIO_ACTIVE_HIGH>
        , <&gpio0 29 GPIO_ACTIVE_HIGH>
        , <&gpio0 02 GPIO_ACTIVE_HIGH>
        , <&gpio1 15 GPIO_ACTIVE_HIGH>
        ;
};