## boards/shields/Joose/Kconfig.shield
```kconfig
config SHIELD_JOOSE_LEFT
    def_bool $(shields_list_contains,Joose_Left)
config SHIELD_JOOSE_RIGHT
    def_bool $(shields_list_contains,Joose_Right)
```

## config/Kconfig.shield
```kconfig
config SHIELD_JOOSE_LEFT
    def_bool $(shields_list_contains,joose_left)
config SHIELD_JOOSE_RIGHT
    def_bool $(shields_list_contains,joose_right)
```

## config/west.yml
```yaml
manifest:
  remotes:
    - name: zmkfirmware
      url-base: https://github.com/zmkfirmware
    - name: sitrucy
      url-base: https://github.com/SitrucyCodes
  projects:
    - name: zmk
      remote: zmkfirmware
      revision: main
      import: app/west.yml
    - name: keyboard
      remote: sitrucy
      revision: main
  self:
    path: config
```
